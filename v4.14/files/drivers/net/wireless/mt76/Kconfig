## v4.14/files/drivers/net/wireless/mt76/Kconfig
```kconfig
# SPDX-License-Identifier: GPL-2.0-only
config MT76_CORE
	tristate

config MT76_LEDS
	bool
	depends on MT76_CORE
	depends on LEDS_CLASS=y || MT76_CORE=LEDS_CLASS
	default y

config MT76_USB
	tristate
	default m

config MT76_SDIO
	tristate
	default m

config MT7615_COMMON
	select MT76_CORE
	tristate

config MT7615E
	tristate "MediaTek MT7615E and MT7663E (PCIe) support"
	select MT76_CORE
	depends on PCI
	select MT7615_COMMON
	depends on m

config MT7663_USB_SDIO_COMMON
	tristate
	select MT7615_COMMON

config MT7663U
	tristate "MediaTek MT7663U (USB) support"
	select MT76_USB
	select MT7663_USB_SDIO_COMMON
	depends on USB
	depends on m

config MT7663S
	tristate "MediaTek MT7663S (SDIO) support"
	select MT76_SDIO
	select MT7663_USB_SDIO_COMMON
	depends on MMC
	depends on m
```
